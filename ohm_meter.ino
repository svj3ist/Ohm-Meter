#include <SPI.h>
#include <Wire.h>
#include <Adafruit_GFX.h>
#include <Adafruit_SSD1306.h>

#define SCREEN_WIDTH 128 // OLED display width, in pixels
#define SCREEN_HEIGHT 32 // OLED display height, in pixels
#define OLED_RESET     4 // Reset pin # (or -1 if sharing Arduino reset pin)
Adafruit_SSD1306 display(SCREEN_WIDTH, SCREEN_HEIGHT, &Wire, OLED_RESET);

#define NUM_READINGS 100
int average2;
int average;
long sum2;
long sum;
int Vin=5;        // напряжение на выводе 5V arduino
float Vout=0;     // напряжение на выводе A0 arduino
float R1=220;    // значение известного сопротивления
float R2=0;// значение неизвестного сопротивления
float R3=0;
int a2d_data=0;
int a3d_data=0;    
float buffer=0; 
float buffer2=0;
#define LOGO_HEIGHT   32
#define LOGO_WIDTH    128
static const unsigned char PROGMEM Delta[] = {
0x00, 0x00, 0x00, 0x00, 0x00, 0x00, 0x00, 0x00, 0x00, 0x00, 0x00, 0x00, 0x00, 0x00, 0x00, 0x00,
0x0F, 0xFF, 0xFF, 0xFF, 0xE0, 0x0F, 0xF8, 0x1F, 0xF8, 0x03, 0x80, 0x60, 0x1F, 0xFC, 0x0C, 0x00,
0x0F, 0xFF, 0xFF, 0xFF, 0xE0, 0x1F, 0xFC, 0x1F, 0xFC, 0x07, 0x80, 0x70, 0x3F, 0xFE, 0x1E, 0x00,
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0x00, 0x00, 0x00, 0x00, 0x00, 0x00, 0x00, 0x00, 0x00, 0x00, 0x00, 0x00, 0x00, 0x00, 0x00, 0x00
};




void setup() {
 // Serial.begin(9600);
  display.clearDisplay();
display.begin();
display.clearDisplay();
display.invertDisplay(true);
  display.drawBitmap(
    (display.width()  - LOGO_WIDTH ),
    (display.height() - LOGO_HEIGHT),
    Delta, LOGO_WIDTH, LOGO_HEIGHT, 1);
  display.display();
  tone(10,1000,600);
  delay(100);
  tone(10,1400,800);
  delay(1400);
noTone(10);
  display.invertDisplay(false);
  display.clearDisplay();
  display.display();
  pinMode(10,OUTPUT);
}
void loop() {
//a2d_data=analogRead(A6);
  long sum = 0;                                  // локальная переменная sum
  for (int i = 0; i < NUM_READINGS; i++) {      // согласно количеству усреднений
    sum += analogRead(A6);                        // суммируем значения с любого датчика в переменную sum
  }
  average = sum / NUM_READINGS;     
//if(average)
//  {

buffer=average*Vin;
Vout=(buffer)/1024.0;
buffer= (Vin/Vout) -1;
R2=R1*buffer;
  
//a3d_data=analogRead(A7);
 long sum2 = 0;                                  // локальная переменная sum
  for (int f = 0; f < NUM_READINGS; f++) {      // согласно количеству усреднений
    sum2 += analogRead(A7);                        // суммируем значения с любого датчика в переменную sum
  }
  average2 = sum2 / NUM_READINGS;

//  if(average2)
//{
    
buffer2=average2*Vin;
Vout=(buffer2)/1024.0;
buffer2= (Vin/Vout) -1;
R3=R1*buffer2;

  if (R2 < 500 || R3 < 500){
float green = constrain(R2, 0, 500);
float orange = constrain(R3, 0, 500);
  display.clearDisplay();
  display.setTextSize(2);
  display.setTextColor(SSD1306_WHITE);
  display.drawLine(60,5,60,15,1);
  display.drawLine(0,10,128,10,1);
  display.setCursor(0,18);
  display.setTextWrap(0);
  if (green >= 500){
  display.print("-X-");
  }
  else {
     display.print(green,1);
     int zvuk = map(R2, 0, 500, 400, 10000);
     tone(10,zvuk);
    }
  display.setCursor(64,18);
  display.setTextWrap(0);
  if (orange >= 500){
  display.print("-X-");
  }
  else {
     display.print(orange,1);
     int zvuk = map(R3, 0, 500, 400, 10000);
     tone(10,zvuk);
    }
  display.setTextSize(1);
  display.setCursor(0,0);
  display.print("Green 1-2");
  display.setCursor(66,0);
  display.print("Orange 3-6");
  display.display();
  
delay (1000);
}
  //}
  //}
else {
  display.clearDisplay(); 
  display.display();
  noTone(10);
}
}
